## config/west.yml
```yaml
manifest:
  remotes:
    - name: zmkfirmware
      url-base: https://github.com/zmkfirmware
      # Additional modules containing boards/shields/custom code can be listed here as well.
      # See:
      # - https://zmk.dev/docs/features/modules
      # - https://docs.zephyrproject.org/3.5.0/develop/west/manifest.html#projects
  projects:
    - name: eyelash_corne
      url: https://github.com/a741725193/zmk-new_corne
      # Last revision with the eyelash_corne_left/right *board* definitions.
      # Newer module revisions (2026-06-05 onward) replace them with shields
      # for nice_nano_v2 and depend on the cormoran/zmk fork.
      revision: d6e05a16d463e07921a833a9dccd2bb8a44ec22e
    - name: zmk
      remote: zmkfirmware
      # Pinned release the module revision above was developed against.
      revision: v0.3.0
      import: app/west.yml
  self:
    path: config
```
